## Kconfig
```kconfig
menu "BLE Bulk Transfer (BBT)"

    menu "Worker task"

        config BBT_RX_QUEUE_DEPTH
            int "RX packet queue depth"
            range 1 256
            default 16
            help
                Complete packets waiting for the worker task. Size it for the worst BLE burst the
                storage or export path can tolerate. Each entry holds one packet of up to
                BBT_MAX_CHUNK_SIZE + 8 bytes.

        config BBT_RX_THREAD_STACK_SIZE
            int "Worker task stack size (bytes)"
            range 2048 65536
            default 4096
            help
                The worker task runs the mode callbacks (on_start, on_chunk, prepare_export, ...):
                add what they need.

        config BBT_RX_THREAD_PRIORITY
            int "Worker task priority"
            range 1 24
            default 3
            help
                FreeRTOS priority of the worker task. Keep it below the task running the BLE host,
                so a slow mode callback (flash write) does not delay BLE events.

        config BBT_RX_THREAD_CORE
            int "Worker task core (-1: no affinity)"
            range -1 1
            default -1
            help
                Core the worker task is pinned to, -1 to let the scheduler choose.

        config BBT_WORKER_POLL_MS
            int "Worker poll period (ms)"
            range 1 1000
            default 20
            help
                Longest wait for a packet before the worker checks the timeouts and sends the
                next export chunks.

    endmenu

    menu "Packets"

        config BBT_MAX_CHUNK_SIZE
            int "Largest chunk payload (bytes)"
            range 1 65535
            default 244
            help
                Upper bound of the chunk size accepted in a START and used for an export. A chunk
                packet is this + 8 bytes and must fit one ATT value (ATT MTU - 3). Call
                bbt_core_set_max_chunk_size() with the negotiated MTU to lower it at run time.

        config BBT_MAX_TOTAL_CHUNKS
            int "Largest number of chunks in one transfer"
            range 1 65535
            default 4096
            help
                Bounds the transfer size (chunks x chunk size) and the receive bitmap
                (one bit per chunk).

        config BBT_MAX_NOTIFY_SIZE
            int "Largest outgoing packet (bytes)"
            range 10 65535
            default 252
            help
                Size of the transmit buffer: the largest export chunk packet (BBT_MAX_CHUNK_SIZE + 8)
                and the largest NACK (5 bytes + bitmap). Keep it at or below ATT MTU - 3 so every
                packet fits one notification or indication. The default fits an ATT MTU of 255.

    endmenu

    menu "Timing"

        config BBT_IDLE_TIMEOUT_MS
            int "Idle timeout (ms)"
            range 100 600000
            default 5000
            help
                A transfer without traffic for this long is aborted.

        config BBT_NACK_RETRY_MAX
            int "NACK retries"
            range 1 255
            default 3
            help
                Repair rounds before a transfer fails.

        config BBT_SENDER_CHUNK_DELAY_MS
            int "Export chunk pacing (ms)"
            range 0 1000
            default 20
            help
                Delay between two export chunks.

        config BBT_BLE_SEND_RETRY_MAX
            int "BLE send attempts"
            range 1 255
            default 10
            help
                Attempts of app_bbt_send() before a packet is given up, when the BLE stack is busy.

        config BBT_BLE_SEND_RETRY_DELAY_MS
            int "BLE send retry delay (ms)"
            range 1 1000
            default 20
            help
                Delay between two attempts of app_bbt_send().

    endmenu

endmenu
```
